## main/Kconfig.projbuild
```kconfig
menu "App Configuration"

    config FIRMWARE_OTA_UPGRADE_URL
        string "firmware upgrade url endpoint"
        default "http://192.168.0.16:8070/vario.bin"
        help
            URL of server which hosts the firmware
            image.

    config WIFI_SSID
        string "SSID of the AP to connect to"
        default "myAP"
        help
            SSID of the AP to connect to.

    config WIFI_PASSWORD
        string "WiFi password of the AP to connect to"
        default "myPass"
        help
            WiFi password of the AP to connect to.

endmenu
```
